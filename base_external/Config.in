## base_external/Config.in
```kconfig
source "$BR2_EXTERNAL_project_base_PATH/package/python-smbus2/Config.in"
source "$BR2_EXTERNAL_project_base_PATH/package/python-bme280/Config.in"
source "$BR2_EXTERNAL_project_base_PATH/package/python-adafruit-blinka/Config.in"
source "$BR2_EXTERNAL_project_base_PATH/package/bme/Config.in"
source "$BR2_EXTERNAL_project_base_PATH/package/mq/Config.in"
source "$BR2_EXTERNAL_project_base_PATH/package/python-rpigpio/Config.in"
source "/home/viswesh/AESD/Project/assignment-9-VisweshBaskaran/buildroot/package/python-gpiozero/Config.in"
```

## base_external/package/aesd-char/Config.in
```kconfig
config BR2_PACKAGE_AESD_CHAR
	bool "aesd-char"
	help
	This package includes the aesd-char device implementation. Helps to understand buildroot external trees and package builds.
```

## base_external/package/aesdchar/Config.in
```kconfig
config BR2_PACKAGE_LDD
	bool "ldd"
	help
	This package includes the aesd-char device implementation. Helps to understand buildroot external trees and package builds.
```

## base_external/package/bme/Config.in
```kconfig
config BR2_PACKAGE_BME
	bool "BME"
	help
	  This package includes fingerprint sample python source code.
	  Helps to understand buildroot external trees and package builds.
```

## base_external/package/ldd/Config.in
```kconfig
config BR2_PACKAGE_AESD_CHAR
	bool "aesdchar"
	help
	This package includes the Misc-modules and Scull components in the rootfs of the image.
	Helps to understand buildroot external trees and package builds.
```

## base_external/package/mq135/Config.in
```kconfig
config BR2_PACKAGE_MQ135
	bool "MQ135"
	help
	  This package includes fingerprint sample python source code.
	  Helps to understand buildroot external trees and package builds.
```

## base_external/package/python-adafruit-blinka/Config.in
```kconfig
config BR2_PACKAGE_PYTHON_ADAFRUIT_BLINKA
	bool "python-adafruit-blinka"
	help
	  This package includes python Adafruit Blinka source code.
	  Helps to understand buildroot external trees and package builds.
```

## base_external/package/python-adafruit-circuitpython-mcp3xxx/Config.in
```kconfig
config BR2_PACKAGE_PYTHON_ADAFRUIT_CIRCUITPYTHON_MCP3xxx
	bool "python-adafruit-circuitpython-mcp3xxx"
	help
	  This package includes python Adafruit Circuitpython mcp source code.
	  Helps to understand buildroot external trees and package builds.
```

## base_external/package/python-bme280/Config.in
```kconfig
config BR2_PACKAGE_PYTHON_BME280
	bool "python-bme280"
	help
	  This package includes python bme280 source code.
	  Helps to understand buildroot external trees and package builds.
```

## base_external/package/python-rpibme280/Config.in
```kconfig
config BR2_PACKAGE_PYTHON_RPIBME280
	bool "python-rpibme280"
	help
	  This package includes RPIBME280 python package.
	  Helps to understand buildroot external trees and package builds.
```

## base_external/package/python-smbus2/Config.in
```kconfig
config BR2_PACKAGE_PYTHON_SMBUS2
	bool "python-smbus2"
	help
	  This package includes python smbus2 source code.
	  Helps to understand buildroot external trees and package builds.
```

## base_external/package/test/Config.in
```kconfig
config BR2_PACKAGE_MYTESTPY
	bool "mytestpy"
	help
	This package includes test. Helps to understand buildroot external trees and package 	builds.
```
